## build/conf/bblayers.conf
```bitbake
# LAYER_CONF_VERSION is increased each time build/conf/bblayers.conf
# changes incompatibly
LCONF_VERSION = "6"

BBPATH = "${TOPDIR}"
BBFILES ?= ""

BBLAYERS ?= " \
  /media/7ac7050f-caf1-4213-98be-fa898f57e4f0/edison-src/out/linux64/poky/meta \
  /media/7ac7050f-caf1-4213-98be-fa898f57e4f0/edison-src/out/linux64/poky/meta-yocto \
  /media/7ac7050f-caf1-4213-98be-fa898f57e4f0/edison-src/out/linux64/poky/meta-yocto-bsp \
  "
BBLAYERS_NON_REMOVABLE ?= " \
  /media/7ac7050f-caf1-4213-98be-fa898f57e4f0/edison-src/out/linux64/poky/meta \
  /media/7ac7050f-caf1-4213-98be-fa898f57e4f0/edison-src/out/linux64/poky/meta-yocto \
  "
```
